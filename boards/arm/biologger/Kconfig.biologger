## boards/arm/biologger/Kconfig.biologger
```kconfig
# Copyright (c) 2024 Marko Vejnovic
# SPDX-License-Identifier: Apache-2.0
# This file tells Zephyr what feature flags this board supports.
# https://martinfowler.com/articles/feature-toggles.html
# You likely do not need to edit this for basic functionality.

config BOARD_OTHER_BIOLOGGER
        bool "Enable the biologger board."
        select SOC_STM32F412RX
```

## boards/arm/biologger/Kconfig.defconfig
```kconfig
# This file tells Zephyr what feature flags this board supports.
# https://martinfowler.com/articles/feature-toggles.html
# You likely do not need to edit this for basic functionality.

if BOARD_OTHER_BIOLOGGER

config TRUTIME_MOCK_GNSS
        bool "Fake the trutime GPS (debugging)."

endif # BOARD_OTHER_BIOLOGGER
```

## boards/arm/biologger/biologger_defconfig
```kconfig
# SPDX-License-Identifier: Apache-2.0
# Specifies which features this board depends on. You likely don't need to edit
# it.

CONFIG_BOARD_OTHER_BIOLOGGER=y

# Enable MPU
CONFIG_ARM_MPU=y

# Enable HW stack protection
CONFIG_HW_STACK_PROTECTION=y

CONFIG_SERIAL=y

# enable GPIO
CONFIG_GPIO=y

# Enable Clocks
CONFIG_CLOCK_CONTROL=y

# enable pin controller
CONFIG_PINCTRL=y

#CONFIG_GNSS=y
#CONFIG_GNSS_NMEA_GENERIC=y

CONFIG_LED=y
CONFIG_LED_GPIO=y
```

## boards/arm/biologger/board.yml
```yaml
# This .yml file tells zephyr that there exists a board called "biologger".
# You likely do not need to edit it for basic work.
board:
  name: biologger
  vendor: other
  socs:
    - name: stm32f412rx
```

## boards/arm/biologger/dts/bindings/gnss-disable.yaml
```yaml
# Copyright (c) 2024 Marko Vejonvic
# SPDX-License-Identifier: Apache-2.0

description: GPIO pin to switch the GNSS module on or off

compatible: "gnss-switch"

properties:
  gpios:
    type: phandle-array
    required: true
    description: |
      The GPIO connected to the gate driver for the MOSFET.
```

## drivers/licor/li_550/Kconfig
```kconfig
# Copyright (c) 2024 Marko Vejnovic
# SPDX-License-Identifier: Apache-2.0
menu "Li-Cor Trisonica Mini"
config LICOR_TRISONICA_MINI
    bool "Enable Licor Trisonica Mini Driver"
    depends on UART_INTERRUPT_DRIVEN

if LICOR_TRISONICA_MINI

module = LICOR_TRISONICA_MINI
module-str = My uart peripheral
source "subsys/logging/Kconfig.template.log_config"

endif # LICOR_TRISONICA_MINI
```

## drivers/sensor/tsic_506f/Kconfig
```kconfig
# Copyright (c) 2024 Marko Vejnovic
# SPDX-License-Identifier: Apache-2.0

config TSIC_506F
        bool "iST TSIC-506F Temperature Sensor"
        default y
        select GPIO
        help
          Enable driver for the iST TSic-506 Zac-Wire Temperature Sensor
```

## drivers/trisonica-mini/Kconfig
```kconfig
config TRISONICA_MINI_DRIVER
        bool "Trisonica Mini Driver"
        default y
        depends on SERIAL
        help
          Enables the Trisonica Mini Driver.
```

## drivers/ximpedance-adc/Kconfig
```kconfig
config XIMPEDANCE_AMP
        bool "XImpedanceAmp Module"
        default y
        depends on ADC && ADC_ADS1X1X
        help
          Enables The XImpedanceAmp module.
```
